## boards/shields/flatcat_split/Kconfig.defconfig
```kconfig
if SHIELD_FLATCAT_LEFT

config ZMK_KEYBOARD_NAME
    default "FlatCat Split"

config ZMK_SPLIT_ROLE_CENTRAL
    default y

endif

if SHIELD_FLATCAT_LEFT || SHIELD_FLATCAT_RIGHT

config ZMK_SPLIT
    default y

endif
```

## boards/shields/flatcat_split/Kconfig.shield
```kconfig
config SHIELD_FLATCAT_LEFT
    def_bool $(shields_list_contains,flatcat_left)

config SHIELD_FLATCAT_RIGHT
    def_bool $(shields_list_contains,flatcat_right)
```

## config/west.yml
```yaml
manifest:
  remotes:
    - name: zmkfirmware
      url-base: https://github.com/zmkfirmware
    - name: jagonmo
      url-base: https://github.com/jagonmo
  projects:
    - name: zmk
      remote: zmkfirmware
      revision: main
      import: app/west.yml
    - name: zmk-pro-rgb
      remote: jagonmo
      revision: split_tests
  self:
    path: config
```
