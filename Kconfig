## Kconfig
```kconfig
# BLE (HID over GATT) to USB bridge for the dongle. Off unless a shield turns it on.

menuconfig ZMK_BT_BRIDGE
    bool "BLE to USB bridge (receiver dongle)"
    depends on ZMK_USB && !ZMK_BLE && !ZMK_SPLIT
    select BT
    select BT_CENTRAL
    select BT_SMP
    select BT_SMP_SC_PAIR_ONLY
    select BT_GATT_CLIENT
    select BT_SETTINGS
    select SETTINGS
    help
      Makes this board a receiver: it connects over Bluetooth to one ZMK
      keyboard and re-emits that keyboard's reports over USB. The keyboard is a
      normal standalone ZMK keyboard; the dongle is one of its Bluetooth
      profiles.

      Needs ZMK_BLE=n: the dongle is not a Bluetooth keyboard itself. Keyboard
      and dongle must be built with the same HID options so the report layouts
      match.

if ZMK_BT_BRIDGE

config ZMK_BT_BRIDGE_PEER_NAME
    string "Name prefix of the keyboard, used for the first pairing"
    default "FlatCat"
    help
      Used only the first time: the dongle connects to the first device that
      advertises the HID service and whose name starts with this. After that it
      is bound to that keyboard's address (stored in settings) and ignores
      every other device, even ones with the same name. Leave empty to accept
      any HID device on the first pairing.

      With several keyboards of the same name nearby, give each keyboard its
      own ZMK_KEYBOARD_NAME and set this to match, or use
      ZMK_BT_BRIDGE_PEER_ADDR.

config ZMK_BT_BRIDGE_PEER_ADDR
    string "Fixed address of the keyboard (optional)"
    default ""
    help
      Binds the dongle to one keyboard from the start, e.g.
      "AA:BB:CC:DD:EE:FF". Takes priority over the name and over the stored
      address. An nRF52 keyboard's address is the chip's factory address, so
      it stays the same even when the keyboard's memory is wiped. The debug
      build (flatcat-bridge-debug) logs it when it finds the keyboard.

config ZMK_BT_BRIDGE_CLEAR_BONDS_ON_START
    bool "Forget the bonded keyboard at every start"
    help
      For pairing tests only: the dongle will pair again each time it starts.
      The keyboard must have the same profile cleared.

config ZMK_BT_BRIDGE_LAMP_ARRAY
    bool "Windows Dynamic Lighting (HID LampArray) on the dongle"
    help
      Exposes HID LampArray to Windows on the dongle's USB port and forwards
      the colours to the keyboard over Bluetooth. The keyboard needs
      CONFIG_RGB_PRO_LAMP_ARRAY_REMOTE=y (zmk-pro-rgb); without it the keys
      work as usual and Dynamic Lighting just has no effect.

      Needs CONFIG_USB_HID_DEVICE_COUNT=2 and the keyboard's LED map
      (rgb_pro_led_map.h in the config folder), which gives the lamp count
      and positions.

if ZMK_BT_BRIDGE_LAMP_ARRAY

config ZMK_BT_BRIDGE_LAMP_PITCH_UM
    int "Distance between neighbouring keys (micrometres)"
    default 19050

config ZMK_BT_BRIDGE_LAMP_UPDATE_US
    int "Shortest update interval reported to Windows (microseconds)"
    default 33000
    help
      33 ms matches the keyboard's default animation tick (RGB_PRO_TICK_MS).

endif # ZMK_BT_BRIDGE_LAMP_ARRAY

config ZMK_BT_BRIDGE_INIT_PRIORITY
    int "Init priority"
    default 95
    range 0 99

endif # ZMK_BT_BRIDGE
```

## config/west.yml
```yaml
manifest:
  remotes:
    - name: zmkfirmware
      url-base: https://github.com/zmkfirmware
    - name: jagonmo
      url-base: https://github.com/jagonmo
  projects:
    - name: zmk
      remote: zmkfirmware
      revision: main
      import: app/west.yml
    - name: zmk-pro-rgb
      remote: jagonmo
      revision: bt-lamp
  self:
    path: config
```
